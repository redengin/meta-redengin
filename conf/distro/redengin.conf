## conf/distro/redengin.conf
```bitbake
DISTRO = "redengin"
DISTRO_NAME = "redengin"
DISTRO_VERSION = "0.0.0"

SDK_VENDOR = "-redengin"
SDK_VERSION = "${@d.getVar('DISTRO_VERSION').replace('snapshot-${METADATA_REVISION}', 'snapshot')}"
SDK_VERSION[vardepvalue] = "${SDK_VERSION}"

MAINTAINER = "redengin"

LOCALCONF_VERSION = "2"

DISTRO_FEATURES ?= "${DISTRO_FEATURES_DEFAULT} \
    ptest \
    systemd \
"

# prefer the latest LTS kernel
PREFERRED_VERSION_linux-yocto ?= "6.6%"
PREFERRED_VERSION_linux-yocto-rt ?= "6.6%"
# PREFERRED_VERSION_linux-yocto ?= "6.12%"
# PREFERRED_VERSION_linux-yocto-rt ?= "6.12%"

INIT_MANAGER = "systemd"

# leverage poky's settings
require conf/distro/include/poky-world-exclude.inc
require conf/distro/include/no-static-libs.inc
require conf/distro/include/yocto-uninative.inc
require conf/distro/include/security_flags.inc
INHERIT += "uninative"

# add poky sanity bbclass
INHERIT += "poky-sanity"
# QA check settings - a little stricter than the OE-Core defaults
# (none currently necessary as we now match OE-Core)
#WARN_TO_ERROR_QA = "X"
#WARN_QA_remove = "${WARN_TO_ERROR_QA}"
#ERROR_QA_append = " ${WARN_TO_ERROR_QA}"

# Enable creation of SPDX manifests (Build of Materials) by default
INHERIT += "create-spdx"
```

## conf/layer.conf
```bitbake
# We have a conf and classes directory, add to BBPATH
BBPATH .= ":${LAYERDIR}"

# We have recipes-* directories, add to BBFILES
BBFILES += "${LAYERDIR}/recipes-*/*/*.bb \
            ${LAYERDIR}/recipes-*/*/*.bbappend"

BBFILE_COLLECTIONS += "meta-redengin"
BBFILE_PATTERN_meta-redengin = "^${LAYERDIR}/"
BBFILE_PRIORITY_meta-redengin = "6"

LAYERDEPENDS_meta-redengin = "core"
LAYERSERIES_COMPAT_meta-redengin = "scarthgap"
```
